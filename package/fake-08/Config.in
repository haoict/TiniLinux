## package/fake-08/Config.in
```kconfig
config BR2_PACKAGE_FAKE_08
  bool "fake-08"
  select BR2_PACKAGE_RETROARCH
  help
    Fake-08 libretro (Retroarch core for PICO-8 simulator)
```

## package/initramfs/Config.in
```kconfig
config BR2_PACKAGE_INITRAMFS
    bool "initramfs"

if BR2_PACKAGE_INITRAMFS

config BR2_PACKAGE_INITRAMFS_NFS
    bool "enable mount nfs as rootfs support"
    depends on BR2_USE_WCHAR

endif
```

## package/pi-st7789v-240x240-dtbo/Config.in
```kconfig
config BR2_PACKAGE_PI_ST7789V_240X240_DTBO
    bool "pi-st7789v-240x240-dtbo"
    select BR2_PACKAGE_HOST_DTC
```

## package/simple-launcher/Config.in
```kconfig
config BR2_PACKAGE_SIMPLE_LAUNCHER
    bool "simple-launcher"
    select BR2_PACKAGE_SDL2
    select BR2_PACKAGE_SDL2_TTF
    help
      Simple Launcher program
```

## package/simple-terminal-2/Config.in
```kconfig
config BR2_PACKAGE_SIMPLE_TERMINAL_2
  bool "simple-terminal-2"
  select BR2_PACKAGE_SDL2
  help
    Simple Terminal 2
```

## package/simple-terminal/Config.in
```kconfig
config BR2_PACKAGE_SIMPLE_TERMINAL
  bool "simple-terminal"
  select BR2_PACKAGE_SDL2
  select BR2_PACKAGE_SDL2_TTF
  help
    Simple Terminal
```

## package/tic-80/Config.in
```kconfig
config BR2_PACKAGE_TIC_80
  bool "tic-80"
  select BR2_PACKAGE_RETROARCH
  help
    TIC-80 libretro (Retroarch core for TIC-80)
```
